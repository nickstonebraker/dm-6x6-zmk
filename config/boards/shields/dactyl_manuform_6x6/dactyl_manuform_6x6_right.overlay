#include "dactyl_manuform_6x6.dtsi"

&default_transform {
    col-offset = <6>;
};

&kscan0 {
    diode-direction = "col2row";
    row-gpios
        = <&gpio0 6  (GPIO_ACTIVE_HIGH | GPIO_PULL_DOWN)> // Row 0
        , <&gpio0 8  (GPIO_ACTIVE_HIGH | GPIO_PULL_DOWN)> // Row 1
        , <&gpio0 17 (GPIO_ACTIVE_HIGH | GPIO_PULL_DOWN)> // Row 2
        , <&gpio0 20 (GPIO_ACTIVE_HIGH | GPIO_PULL_DOWN)> // Row 3
        , <&gpio0 22 (GPIO_ACTIVE_HIGH | GPIO_PULL_DOWN)> // Row 4
        , <&gpio0 24 (GPIO_ACTIVE_HIGH | GPIO_PULL_DOWN)> // Row 5
        , <&gpio1 0  (GPIO_ACTIVE_HIGH | GPIO_PULL_DOWN)> // Row 6
        ;
    col-gpios
        = <&gpio0 11 GPIO_ACTIVE_HIGH> // Col 5
        , <&gpio1 4  GPIO_ACTIVE_HIGH> // Col 4
        , <&gpio1 6  GPIO_ACTIVE_HIGH> // Col 3
        , <&gpio0 2  GPIO_ACTIVE_HIGH> // Col 2
        , <&gpio0 29 GPIO_ACTIVE_HIGH> // Col 1
        , <&gpio0 10 GPIO_ACTIVE_HIGH> // Col 0
        ;
};
