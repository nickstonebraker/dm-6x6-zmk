#include "dactyl_manuform_6x6.dtsi"

&kscan0 {
    diode-direction = "row2col";
    col-gpios
        = <&gpio0 11 (GPIO_ACTIVE_HIGH | GPIO_PULL_DOWN)> // Col 0 (Was Col 5)
        , <&gpio1 4  (GPIO_ACTIVE_HIGH | GPIO_PULL_DOWN)> // Col 1 (Was Col 4)
        , <&gpio1 6  (GPIO_ACTIVE_HIGH | GPIO_PULL_DOWN)> // Col 2 (Was Col 3)
        , <&gpio0 2  (GPIO_ACTIVE_HIGH | GPIO_PULL_DOWN)> // Col 3 (Was Col 2)
        , <&gpio0 29 (GPIO_ACTIVE_HIGH | GPIO_PULL_DOWN)> // Col 4 (Was Col 1)
        , <&gpio0 10 (GPIO_ACTIVE_HIGH | GPIO_PULL_DOWN)> // Col 5 (Was Col 0)
        ;
};
