## config/west.yml
```yaml
manifest:
  remotes:
    - name: zmkfirmware
      url-base: https://github.com/zmkfirmware
    - name: my_local_repo
      url-base: https://github.com/nickstonebraker/dm-6x6-zmk
  projects:
    - name: zmk
      remote: zmkfirmware
      revision: main
      import: app/west.yml
```
